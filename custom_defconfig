## custom_defconfig
```kconfig
CONFIG_HAVE_KPROBES=y
CONFIG_KPROBE_EVENTS=y

CONFIG_KSU=y
CONFIG_KSU_SUSFS=y

CONFIG_KSU_SUSFS_HAS_MAGIC_MOUNT=y
# CONFIG_KSU_SUSFS_AUTO_ADD_SUS_KSU_DEFAULT_MOUNT is not set
# CONFIG_KSU_SUSFS_AUTO_ADD_SUS_BIND_MOUNT is not set
# CONFIG_KSU_SUSFS_AUTO_ADD_TRY_UMOUNT_FOR_BIND_MOUNT is not set
```
